SECTIONS { .text 0x8fb9400 : { *(.text*) *(.rodata*) } .bss 0x8fff100 (NOLOAD) : { *(.bss*) } /DISCARD/ : { *(.eh_frame*) *(.comment*) *(.note*) } }
csnd_old_electronic_commit = 0x8f98110;
csnd_old_focus_commit = 0x8f983a0;
csnd_menu_request_status = 0x8f98440;
csnd_original_event_body = 0x19d799c;
csnd_parent_parameter = 0x2915f1c;
csnd_original_profile_update = 0x1c1e98c;
csnd_original_parent_refresh = 0x221d418;
